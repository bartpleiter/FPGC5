; Attempt at minimal code to write logo to screen using window plane
; for bootloader if success
; currently does not clean vram first

Main:
    ; set palette table
    load32 0xC00400 r1      ; pallette address
    load 0xFF r2            ; white for 11 bytes, others black
    write 0 r1 r2

    ; copy pattern table
    load32 0xC00000 r3      ; r3 = data dest
    addr2reg LOGOTABLE r2   ; r2 = data source

    add r3 253 r1           ; r1 = loop end (if r3 matches)

    CopyPatternLoop:
        copy 0 r2 r3        ; copy data to vram
        add r2 1 r2         ; increase source address
        add r3 1 r3         ; increase dest address

        beq r3 r1 2         ; keep looping until all 252 words are copied
        jump CopyPatternLoop


    ; copy window tile table
    load32 0xC015E4 r3      ; r3 = data dest: window tile address 0xC01420 + position offset
    addr2reg TILETABLE r2   ; r2 = data source

    load 0 r4               ; r4 = loop counter
    load 96 r1              ; r1 = loop end
    load 16 r5              ; r5 = next line counter
    load 32 r8              ; r8 = shift variable


    CopyTileLoop:
        sub r8 8 r8         ; remove 8 from shift variable
        read 0 r2 r10       ; read data
        shiftr r10 r8 r10   ; shift data to right
        write 0 r3 r10      ; write shifted data to vram
        bne r0 r8 3         ; if we shifted the last byte
            add r2 1 r2         ; increase source address
            load 32 r8          ; set shift variable back
        add r3 1 r3         ; increase dest address
        sub r5 1 r5         ; reduce line counter
        add r4 1 r4         ; increase counter

        bne r5 r0 3
            load 16 r5
            add r3 24 r3

        beq r4 r1 2         ; keep looping until all tiles are copied
        jump CopyTileLoop

    halt


Int1:
    reti

Int2:
    reti

Int3:
    reti

Int4:
    reti                    ; return from interrupt

TILETABLE:
.db 0  1  2  3  4  5  0  0  0  0  0  0  0  0  0  0
.db 6  7  8  9  10 11 12 0  0  0  0  0  0  0  0  0
.db 13 14 15 16 17 18 19 20 21 22 23 24 25 26 27 28
.db 29 30 31 32 33 34 35 36 37 38 39 40 41 42 43 44
.db 45 46 47 48 49 50 51 0  0  52 53 54 55 56 0  57
.db 58 59 60 61 62 63 0  0  0  0  0  0  0  0  0  0

LOGOTABLE: ; 252 words long
.dw 0 0 0 0 ; tile 0, background, so always empty
.dw 0b00000000000000000000000000000011
.dw 0b00000000000000110000000000000000
.dw 0b00000000110000000000001111110000
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.dw 0b00000000000000000000000000000000 ; tile  63