; First FPGC4 game: a platformer

; Memory locations:
; 0x400_0000     Frame counter
; 0x400_0001     Frame counter previous


; for debugging to pc
`include lib/UART.asm
; for basic functions
`include lib/STD.asm
; for graphics operations
`include lib/GFX.asm

; DATA INCLUDES
`include data_lv1.asm


Main:

    savpc r15
    push r15
    jump GFX_initVram


    ; load pattern table
    addr2reg ASCIITABLE r1 
    savpc r15
    push r15
    jump GFX_copyPatternTable

    ; load palette table
    addr2reg PALETTETABLE r1 
    savpc r15
    push r15
    jump GFX_copyPaletteTable
    
    ; copy level 1
    addr2reg LEVEL_1_DATA r1
    savpc r15
    push r15
    jump CopyLevelToBG



    ; Sprite test
    load32 0xC02632 r1

    load 64 r2
    write 0 r1 r2
    load 196 r2
    write 1 r1 r2
    load 21 r2
    write 2 r1 r2
    load 0 r2
    shiftl r2 4 r2
    write 3 r1 r2

    ; Reset RAM
    load32 0x400000 r1
    write 0 r1 r0
    write 1 r1 r0
    
    jump GameLoop

    halt    



GameLoop:
    ; SNES controller address
    load32 0xC02622 r1      ; r1 = Controller address 0xC02622
    read 0 r1 r2            ; r2 = button data

    and r2 0b10000000 r3
    beq r3 r0 5
        load32 0xC02632 r1
        read 0 r1 r2
        add r2 1 r2
        write 0 r1 r2




    WaitNewFrame:
        load32 0x400000 r1
        read 1 r1 r2            ; r2 = frame cnt prev
        read 0 r1 r3            ; r3 = current frame cnt

        bne r2 r3 2             ; keep waiting until frame cnts differ
            jump WaitNewFrame

    write 1 r1 r3       ; write back new previous frame cnt
    jump GameLoop



; level to copy in reg1
CopyLevelToBG:

    ; TODO HERE: READ X TILE OFFSET AND APPLY
    add r1 0 r1

    load 26 r8                      ; lines in level
    load 0 r9                       ; line copy loop variable

    ; vram address
    load32 0xC00420 r2              ; r2 = vram addr 1056+4096 0xC01420          

    add r2 256 r2                 ; start at 4th line

    CopyLevelToBG_Line:
        ; loop variables
        load 0 r3                       ; r3 = loopvar
        load 40 r4                      ; r4 = loopmax
        or r2 r0 r5                     ; r5 = vram addr with offset
        or r1 r0 r6                     ; r6 = level addr with offset
        load 0 r7                       ; r7 = read tile data
        load 0 r10                      ; r10 = tile id to compare against
        load 0 r11                      ; r11 = palette value to write

        ; copy loop
        Copyleveltestloop:
            read 0 r6 r7                ; read level tile
            write 0 r5 r7               ; write tile to vram
            
            ; write palette based on tile id

            ; background
            load 5 r10
            bne r7 r10 4
                load 2 r11              ; palette to use for this tile
                write 2048 r5 r11       ; write palette index to vram
                jump Copyleveltestloop_EndPalette   ; skip to end

            ; upward spikes
            load 32 r10
            bne r7 r10 4
                load 3 r11              ; palette to use for this tile
                write 2048 r5 r11       ; write palette index to vram
                jump Copyleveltestloop_EndPalette   ; skip to end

            ; downward spikes
            load 40 r10
            bne r7 r10 4
                load 3 r11              ; palette to use for this tile
                write 2048 r5 r11       ; write palette index to vram
                jump Copyleveltestloop_EndPalette   ; skip to end

            ; arrow shooters
            load 8 r10
            bne r7 r10 4
                load 4 r11              ; palette to use for this tile
                write 2048 r5 r11       ; write palette index to vram
                jump Copyleveltestloop_EndPalette   ; skip to end


            load 1 r11              ; default
            write 2048 r5 r11       ; write palette index to vram
            Copyleveltestloop_EndPalette:

            add r5 1 r5             ; incr vram address
            add r6 1 r6             ; incr level address 
            add r3 1 r3             ; incr counter
            beq r3 r4 2             ; keep looping until all data is copied
            jump Copyleveltestloop




    add r1 LEVEL_1_WIDTH r1     ; move to next level line
    add r2 64 r2                ; move to next bg line
    add r9 1 r9                 ; increase loopvar

    beq r8 r9 2                 ; copy next line untill all lines are copied
        jump CopyLevelToBG_Line


    ; return
    pop r15
    jumpr 3 r15








WINDOWTEXT:
.ds "Graphics printing test :O"

BACKGROUNDTILES:
.db 176 176 177 177 178 178





Int1:
    reti

Int2:
    reti

Int3:
    reti

Int4:
    ; backup regs
    push r1
    push r2

    load32 0x400000 r1      ; r1 = frame counter address

    read 0 r1 r2            ; r2 = frame counter
    add r2 1 r2             ; increase frame counter
    write 0 r1 r2           ; write new frame counter back

    ; restore regs
    pop r2
    pop r1

    reti                    ; return from interrupt



PALETTETABLE:
.dw 0b00000000111111110000000011111111
.dw 0b01000100101011010110100011010101  ; Default/Ground
.dw 0b00100100000000000100010000000000  ; Background cave
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.dw 0b00000000000000000000000000000000


ASCIITABLE:
.dw 0b00000000000000000000000000000000
.dw 0b00000000000000000000000000000000
.dw 0b00000000000000000000000000000000
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.dw 0b00000000000000000000000000000000 ; tile  47
